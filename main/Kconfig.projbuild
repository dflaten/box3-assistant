## main/Kconfig.projbuild
```kconfig
menu "Hue Voice"

config HUE_WIFI_SSID
    string "Wi-Fi SSID"
    default ""

config HUE_WIFI_PASSWORD
    string "Wi-Fi password"
    default ""

config HUE_WIFI_MAXIMUM_RETRY
    int "Wi-Fi connection retries"
    range 1 100
    default 10

config HUE_BRIDGE_IP
    string "Hue bridge IP address"
    default ""

config HUE_BRIDGE_API_KEY
    string "Hue bridge API key"
    default ""

config HUE_BRIDGE_GROUP_ID
    string "Hue group ID"
    default "2"

config HUE_MIC_GAIN_DB
    int "Microphone gain in dB"
    range 0 37
    default 30

config ASSISTANT_WAKE_WORD_THRESHOLD
    int "Wake word trigger threshold in percent (0 = model default)"
    range 0 99
    default 0
    help
      Minimum averaged probability required for the Hi ESP wake word.
      Leave at 0 to use the ESP-SR model default, which is about 63 percent
      for the wn9_hiesp and wn9s_hiesp models. Raise it slightly, for example
      to 66-68, if ordinary speech falsely wakes the device. Values around 75
      or higher can make the wake word unreliable or prevent detection.

config ASSISTANT_HOME_LOCATION_NAME
    string "Assistant home location name"
    default "New York City, NY"

config ASSISTANT_HOME_LATITUDE
    string "Assistant home latitude"
    default "40.7128"

config ASSISTANT_HOME_LONGITUDE
    string "Assistant home longitude"
    default "-74.0060"

config ASSISTANT_HOME_TIMEZONE
    string "Assistant home timezone"
    default "America/New_York"

config WEATHER_BASE_URL
    string "Weather provider base URL"
    default "https://api.open-meteo.com"

config WEATHER_TIMEOUT_MS
    int "Weather request timeout in ms"
    range 1000 30000
    default 8000

config TIME_LOOKUP_BASE_URL
    string "Time lookup provider base URL"
    default "https://api.open-meteo.com"

config TIME_GEOCODING_BASE_URL
    string "Time geocoding provider base URL"
    default "https://geocoding-api.open-meteo.com"

config TIME_LOOKUP_TIMEOUT_MS
    int "Time lookup request timeout in ms"
    range 1000 30000
    default 8000

config TTS_PIPER_ENABLED
    bool "Enable local Piper TTS playback"
    default y

config TTS_PIPER_BASE_URL
    string "Local Piper TTS base URL"
    default ""

config TTS_PIPER_SYNTH_PATH
    string "Local Piper TTS synthesis path"
    default "/"

config TTS_PIPER_EVENT_SOCKET
    bool "Use Piper event socket protocol"
    default y

config TTS_PIPER_VOICE
    string "Local Piper TTS voice"
    default ""

config TTS_PIPER_SEND_JSON
    bool "Send local Piper TTS requests as JSON"
    default n

config TTS_PIPER_TIMEOUT_MS
    int "Local Piper TTS timeout in ms"
    range 1000 30000
    default 20000

config TTS_PIPER_VOLUME_PERCENT
    int "Speaker playback volume percent"
    range 0 100
    default 55

config LOCAL_STT_ENABLED
    bool "Enable local STT for follow-up voice capture"
    default y

config LOCAL_STT_BASE_URL
    string "Local STT base URL"
    default ""

config LOCAL_STT_TIMEOUT_MS
    int "Local STT timeout in ms"
    range 1000 30000
    default 10000

config LOCAL_STT_CAPTURE_MS
    int "Follow-up voice capture duration in ms"
    range 1000 10000
    default 3000

config TIMER_MAX_DURATION_SECONDS
    int "Maximum accepted timer duration in seconds"
    range 1 86400
    default 86400

config INTEGRATION_HUE_ENABLED
    bool "Enable Hue voice control"
    default y

config INTEGRATION_WEATHER_ENABLED
    bool "Enable weather voice queries"
    default y

config INTEGRATION_TIMER_ENABLED
    bool "Enable voice timers"
    default y

config INTEGRATION_FIREWORKS_ENABLED
    bool "Route wake-word utterances through Fireworks AI"
    default n

config FIREWORKS_BASE_URL
    string "Fireworks inference API base URL"
    default "https://api.fireworks.ai/inference/v1"

config FIREWORKS_API_KEY
    string "Fireworks API key"
    default ""

config FIREWORKS_MODEL
    string "Fireworks model name"
    default ""

config FIREWORKS_TIMEOUT_MS
    int "Fireworks request timeout in ms"
    range 1000 60000
    default 15000

config FIREWORKS_MAX_TOKENS
    int "Maximum response tokens requested from Fireworks"
    range 32 1024
    default 200

config VOICE_ROUTING_CAPTURE_MS
    int "Routed voice capture duration in ms"
    range 1000 15000
    default 6000

config VOICE_ROUTING_SESSION_TIMEOUT_MS
    int "Routed interaction session timeout in ms"
    range 10000 180000
    default 90000

config VOICE_ROUTING_EARLY_STOP_ENABLED
    bool "End routed capture early after trailing silence"
    default y

config VOICE_ROUTING_MIN_CAPTURE_MS
    int "Minimum routed capture duration before silence can end it in ms"
    depends on VOICE_ROUTING_EARLY_STOP_ENABLED
    range 0 15000
    default 1000

config VOICE_ROUTING_SILENCE_MS
    int "Trailing silence required to end routed capture in ms"
    depends on VOICE_ROUTING_EARLY_STOP_ENABLED
    range 200 5000
    default 1200

config VOICE_ROUTING_SPEECH_RMS_THRESHOLD
    int "RMS amplitude that counts as speech during routed capture"
    depends on VOICE_ROUTING_EARLY_STOP_ENABLED
    range 1 32767
    default 50
    help
      Raw PCM16 root-mean-square amplitude at or above which a routed capture
      chunk counts as speech. A capture that never reaches this level is
      discarded before STT or the model is called.

      On the BOX-3 with CONFIG_HUE_MIC_GAIN_DB=30, room noise usually measures
      around 10 RMS and normal speech measures roughly 150-700 RMS. The default
      of 50 leaves margin above the noise floor without rejecting quiet speech.
      Raise it if background noise is being sent to STT, or lower it if soft
      speech is being discarded or reported as "I didn't catch that". Values
      near 600 are too high for the BOX-3 microphone path and reject normal
      commands.

config VOICE_ROUTING_SILENCE_RMS_THRESHOLD
    int "RMS amplitude below which routed capture counts as silence"
    depends on VOICE_ROUTING_EARLY_STOP_ENABLED
    range 1 32767
    default 150
    help
      Raw PCM16 root-mean-square amplitude below which captured audio counts
      toward CONFIG_VOICE_ROUTING_SILENCE_MS after speech has started. Audio at
      or above this level resets the silence timer. Keep this above room-noise
      transients and at or above CONFIG_VOICE_ROUTING_SPEECH_RMS_THRESHOLD.

      On the BOX-3, steady room noise can be near 10 RMS, but fan and room
      transients plus the tail of the wake word can briefly reach about
      100-120 RMS. The default of 150 keeps those transients from holding the
      capture open while staying below normal command speech, which usually
      measures above 180 RMS.

      Values lower than CONFIG_VOICE_ROUTING_SPEECH_RMS_THRESHOLD are raised to
      that threshold automatically.

config VOICE_ROUTING_FASTPATH_ENABLED
    bool "Run local command recognition during routed capture for a fast path"
    default n
    help
      Experimental. The fast path currently feeds raw microphone audio to
      MultiNet instead of the AFE-processed stream, so recognition is
      unreliable. It also forces the capture to stay open for
      CONFIG_VOICE_ROUTING_FASTPATH_WINDOW_MS. Enable only for testing while
      the fast path is being moved onto the AFE output.

config VOICE_ROUTING_FASTPATH_WINDOW_MS
    int "Time allowed for the local fast path before routed understanding in ms"
    depends on VOICE_ROUTING_FASTPATH_ENABLED
    range 500 10000
    default 3000

config VOICE_ROUTING_FASTPATH_MIN_CONFIDENCE
    int "Minimum local match confidence in percent for the fast path"
    depends on VOICE_ROUTING_FASTPATH_ENABLED
    range 50 100
    default 90

config FIREWORKS_COST_ENABLED
    bool "Show Fireworks monthly spend on the assistant screen"
    default n

config FIREWORKS_COST_BASE_URL
    string "Fireworks account API base URL"
    default "https://api.fireworks.ai/v1"

config FIREWORKS_ACCOUNT_ID
    string "Fireworks account ID"
    default ""

config FIREWORKS_COST_KEY_ID
    string "Fireworks API key ID to report cost for"
    default ""

config FIREWORKS_COST_REFRESH_SECONDS
    int "Fireworks cost refresh interval in seconds"
    range 60 86400
    default 3600

endmenu
```
